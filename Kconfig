## Kconfig
```kconfig
menuconfig ZMK_ESP32_STATUS_UART
    bool "ESP32 display status UART"
    default n
    depends on SERIAL
    help
      Sends a compact keyboard status line to an ESP32 display over UART.

if ZMK_ESP32_STATUS_UART

config ZMK_ESP32_STATUS_UART_PERIODIC_MS
    int "Periodic status refresh interval"
    default 5000
    help
      Sends a full status line this often, even when no ZMK event changed.

config ZMK_ESP32_STATUS_UART_EVENT_DELAY_MS
    int "Event send delay"
    default 25
    help
      Short delay used to coalesce rapid ZMK events into one UART line.

config ZMK_ESP32_STATUS_UART_MAX_PERIPHERALS
    int "Maximum peripheral batteries to report"
    default 6
    range 1 9

config ZMK_ESP32_BT_PROFILE_1_LABEL
    string "BT profile 1 display label"
    default ""

config ZMK_ESP32_BT_PROFILE_2_LABEL
    string "BT profile 2 display label"
    default ""

config ZMK_ESP32_BT_PROFILE_3_LABEL
    string "BT profile 3 display label"
    default ""

config ZMK_ESP32_BT_PROFILE_4_LABEL
    string "BT profile 4 display label"
    default ""

config ZMK_ESP32_BT_PROFILE_5_LABEL
    string "BT profile 5 display label"
    default ""

config ZMK_ESP32_BT_PROFILE_6_LABEL
    string "BT profile 6 display label"
    default ""

config ZMK_ESP32_BT_PROFILE_7_LABEL
    string "BT profile 7 display label"
    default ""

config ZMK_ESP32_BT_PROFILE_8_LABEL
    string "BT profile 8 display label"
    default ""

config ZMK_ESP32_DECK_TILE_1_LABEL
    string "ESP32 deck tile 1 label"
    default "Tile 1"

config ZMK_ESP32_DECK_TILE_2_LABEL
    string "ESP32 deck tile 2 label"
    default "Tile 2"

config ZMK_ESP32_DECK_TILE_3_LABEL
    string "ESP32 deck tile 3 label"
    default "Tile 3"

config ZMK_ESP32_DECK_TILE_4_LABEL
    string "ESP32 deck tile 4 label"
    default "Tile 4"

config ZMK_ESP32_DECK_TILE_5_LABEL
    string "ESP32 deck tile 5 label"
    default "Tile 5"

config ZMK_ESP32_DECK_TILE_6_LABEL
    string "ESP32 deck tile 6 label"
    default "Tile 6"

config ZMK_ESP32_DECK_TILE_7_LABEL
    string "ESP32 deck tile 7 label"
    default "Tile 7"

config ZMK_ESP32_DECK_TILE_8_LABEL
    string "ESP32 deck tile 8 label"
    default "Tile 8"

config ZMK_ESP32_DECK_TILE_9_LABEL
    string "ESP32 deck tile 9 label"
    default "Tile 9"

config ZMK_ESP32_PROFILE_NAMING
    bool "Per-profile BT device name suffix"
    default n
    select BT_DEVICE_NAME_DYNAMIC
    help
      When enabled the BT device name is changed to "<BT_DEVICE_NAME>-BT<N>"
      whenever the active BLE profile changes. Hosts must re-pair to see the
      new name.

endif
```

## boards/shields/esp32_status_dongle/Kconfig.defconfig
```kconfig
if SHIELD_ESP32_STATUS_DONGLE

config ZMK_ESP32_STATUS_UART
    default y

endif
```

## boards/shields/esp32_status_dongle/Kconfig.shield
```kconfig
config SHIELD_ESP32_STATUS_DONGLE
    def_bool $(shields_list_contains,esp32_status_dongle)
```

## dts/bindings/zmk,bt-profile-names.yaml
```yaml
description: BT profile display names for ESP32 status dongle

compatible: "zmk,bt-profile-names"

child-binding:
  description: A named BT profile entry
  properties:
    label:
      type: string
      required: true
```

## dts/bindings/zmk,esp32-deck-menu-tiles.yaml
```yaml
description: ESP32 deck menu tiles — subtile bindings for the ESP32 touchscreen dongle

compatible: "zmk,esp32-deck-menu-tiles"

child-binding:
  description: A menu tile container (any of the 9 main deck tiles marked as menu tile)
  child-binding:
    description: A subtile within a menu tile
    properties:
      label:
        type: string
        required: false
      bindings:
        type: phandle-array
        required: true
```

## dts/bindings/zmk,esp32-deck.yaml
```yaml
description: ESP32 display deck tile configuration

compatible: "zmk,esp32-deck"

child-binding:
  description: ESP32 display deck tile
  properties:
    label:
      type: string
      description: Label sent to the ESP32 display for this tile.
    bindings:
      type: phandle-array
      description: Future ZMK behavior binding for this tile.
```

## dts/bindings/zmk,esp32-volume.yaml
```yaml
description: ESP32 volume control bindings — vol up, vol down, mute

compatible: "zmk,esp32-volume"

child-binding:
  description: A single volume action (vol_up / vol_dn / mute)
  properties:
    bindings:
      type: phandle-array
      required: true
```
